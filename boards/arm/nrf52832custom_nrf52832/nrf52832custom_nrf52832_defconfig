## boards/arm/nrf52832custom_nrf52832/nrf52832custom_nrf52832_defconfig
```kconfig
# SPDX-License-Identifier: Apache-2.0

CONFIG_SOC_SERIES_NRF52X=y
CONFIG_SOC_NRF52832_QFAA=y
CONFIG_BOARD_NRF52832CUSTOM_NRF52832=y

# Enable MPU
CONFIG_ARM_MPU=y

# Enable hardware stack protection
CONFIG_HW_STACK_PROTECTION=y

# Enable RTT
CONFIG_USE_SEGGER_RTT=n

# enable GPIO
CONFIG_GPIO=y

# CONFIG_CONSOLE=n
# CONFIG_SERIAL=n

# CONFIG_CLOCK_CONTROL_NRF_K32SRC_XTAL=y
CONFIG_CLOCK_CONTROL_NRF_K32SRC_RC=y
CONFIG_CLOCK_CONTROL_NRF_K32SRC_250PPM=y
```

## boards/arm/nrf52840custom_nrf52840/Kconfig
```kconfig
# nRF52840 Custom NRF52840 board configuration

# Copyright (c) 2018 Nordic Semiconductor ASA
# SPDX-License-Identifier: Apache-2.0

if BOARD_NRF52840CUSTOM_NRF52840

config BOARD_ENABLE_DCDC
	bool "Enable DCDC mode"
	select SOC_DCDC_NRF52X
	default y

endif # BOARD_NRF52840CUSTOM_NRF52840
```

## boards/arm/nrf52840custom_nrf52840/Kconfig.board
```kconfig
# nRF52840 Custom NRF52840 board configuration

# Copyright (c) 2018 Nordic Semiconductor ASA
# SPDX-License-Identifier: Apache-2.0

config BOARD_NRF52840CUSTOM_NRF52840
	bool "nRF52840 CUSTOM NRF52840"
	depends on SOC_NRF52840_QIAA
```

## boards/arm/nrf52840custom_nrf52840/Kconfig.defconfig
```kconfig
# nRF52840 Custom NRF52840 board configuration
#
# Copyright (c) 2018 Nordic Semiconductor ASA
#
# SPDX-License-Identifier: Apache-2.0

if BOARD_NRF52840CUSTOM_NRF52840

config BOARD
	default "nrf52840custom_nrf52840"

if USB

config USB_NRFX
	default y

config USB_DEVICE_STACK
	default y

endif # USB

config BT_CTLR
	default BT

endif # BOARD_NRF52840CUSTOM_NRF52840
```

## boards/arm/nrf52840custom_nrf52840/nrf52840custom_nrf52840_defconfig
```kconfig
# SPDX-License-Identifier: Apache-2.0

CONFIG_SOC_SERIES_NRF52X=y
CONFIG_SOC_NRF52840_QIAA=y
CONFIG_BOARD_NRF52840CUSTOM_NRF52840=y

# Enable MPU
CONFIG_ARM_MPU=y

# enable GPIO
CONFIG_GPIO=y

# Enable RTT
CONFIG_USE_SEGGER_RTT=n

# Enable UART driver, needed for CDC ACM
CONFIG_SERIAL=n
CONFIG_UART_INTERRUPT_DRIVEN=n

# enable console
CONFIG_CONSOLE=n

# additional board options
CONFIG_GPIO_AS_PINRESET=n
CONFIG_NFCT_PINS_AS_GPIOS=y

CONFIG_CLOCK_CONTROL_NRF_K32SRC_RC=y
# CONFIG_CLOCK_CONTROL_NRF_K32SRC_XTAL=y
CONFIG_CLOCK_CONTROL_NRF_K32SRC_500PPM=y
```
